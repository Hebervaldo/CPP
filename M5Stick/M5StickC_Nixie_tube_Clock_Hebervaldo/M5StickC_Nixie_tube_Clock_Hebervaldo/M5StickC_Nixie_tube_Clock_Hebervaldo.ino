// M5StickC Nixie tube Clock: 2019.06.06
#include "driver/adc.h"
#include <DNSServer.h>
#include "esp_adc_cal.h"
#include <esp_wifi.h>
#include <NTPClient.h> //Biblioteca NTPClient modificada
#include <M5StickC.h>
#include <stdint.h>
#include <VL53L0X.h>
#include <WebServer.h>
#include <Wire.h>
#include <WiFi.h>
#include <WiFiManager.h>
#include <WiFiUdp.h>

static const uint8_t vfd_18x34_0[1224] = {
  0x00, 0x00, 0x00, 0x00, 0x00, 0x00, 0x00, 0x00, 0x00, 0x00, 0x00, 0x00,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 0x00,
  0x00, 0x00, 0x00, 0x00, 0x00, 0x00, 0x00, 0x00, 0x00, 0x00, 0x00, 0x00,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 0x00,
  0x00, 0x00, 0x00, 0x00, 0x00, 0x00, 0x00, 0x00, 0x00, 0x00, 0x00, 0x00,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 0x00,
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  0x00, 0x00, 0x00, 0x00, 0x00, 0x00, 0x00, 0x00, 0x00, 0x00, 0x00, 0x00,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 0x20
};

static const uint8_t vfd_18x34_1[1224] = {
  0x00, 0x00, 0x00, 0x00, 0x00, 0x00, 0x00, 0x00, 0x00, 0x00, 0x00, 0x00,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 0x00,
  0x00, 0x00, 0x00, 0x00, 0x00, 0x00, 0x00, 0x00, 0x00, 0x00, 0x00, 0x00,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 0x00,
  0x00, 0x00, 0x00, 0x00, 0x00, 0x00, 0x00, 0x00, 0x00, 0x00, 0x00, 0x00,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 0x00,
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  0x10, 0x82, 0x00, 0x00, 0x00, 0x00, 0x08, 0x20, 0x08, 0x00, 0x00, 0x00,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 0x00
};

static const uint8_t vfd_18x34_2[1260] = {
  0x00, 0x00, 0x00, 0x00, 0x00, 0x00, 0x00, 0x00, 0x00, 0x00, 0x00, 0x00,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 0x00,
  0x00, 0x00, 0x00, 0x00, 0x00, 0x00, 0x00, 0x00, 0x00, 0x00, 0x00, 0x00,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 0x00,
  0x00, 0x00, 0x00, 0x00, 0x00, 0x00, 0x00, 0x00, 0x00, 0x00, 0x00, 0x00,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 0x00,
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  0x18, 0xc3, 0x08, 0x20, 0x10, 0x60, 0x20, 0xc1, 0x20, 0xa1, 0x08, 0x40,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 0x61
};

static const uint8_t vfd_18x34_3[1224] = {
  0x00, 0x00, 0x00, 0x00, 0x00, 0x00, 0x00, 0x00, 0x00, 0x00, 0x00, 0x00,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 0x00,
  0x00, 0x00, 0x00, 0x00, 0x00, 0x00, 0x00, 0x00, 0x00, 0x00, 0x00, 0x00,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 0x00,
  0x00, 0x00, 0x00, 0x00, 0x00, 0x00, 0x00, 0x00, 0x00, 0x00, 0x00, 0x00,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 0x00,
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  0x18, 0xe3, 0x00, 0x20, 0x10, 0x40, 0x18, 0x81, 0x10, 0x60, 0x00, 0x20,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 0x20
};

static const uint8_t vfd_18x34_4[1224] = {
  0x00, 0x00, 0x00, 0x00, 0x00, 0x00, 0x00, 0x00, 0x00, 0x00, 0x00, 0x00,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 0x00,
  0x00, 0x00, 0x00, 0x00, 0x00, 0x00, 0x00, 0x00, 0x00, 0x00, 0x00, 0x00,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 0x00,
  0x00, 0x00, 0x00, 0x00, 0x00, 0x00, 0x00, 0x00, 0x00, 0x00, 0x00, 0x00,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 0x00,
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  0x31, 0xc7, 0x08, 0x20, 0x10, 0x61, 0x20, 0xa1, 0x18, 0x81, 0x08, 0x40,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 0x61
};

static const uint8_t vfd_18x34_5[1224] = {
  0x00, 0x00, 0x00, 0x00, 0x00, 0x00, 0x00, 0x00, 0x00, 0x00, 0x00, 0x00,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 0x00,
  0x00, 0x00, 0x00, 0x00, 0x00, 0x00, 0x00, 0x00, 0x00, 0x00, 0x00, 0x00,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 0x00,
  0x00, 0x00, 0x00, 0x00, 0x00, 0x00, 0x00, 0x00, 0x00, 0x00, 0x00, 0x00,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 0x00,
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  0x18, 0xe3, 0x00, 0x00, 0x10, 0x40, 0x10, 0x60, 0x10, 0x20, 0x00, 0x00,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 0x00
};

static const uint8_t vfd_18x34_6[1224] = {
  0x00, 0x00, 0x00, 0x00, 0x00, 0x00, 0x00, 0x00, 0x00, 0x00, 0x00, 0x00,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 0x00,
  0x00, 0x00, 0x00, 0x00, 0x00, 0x00, 0x00, 0x00, 0x00, 0x00, 0x00, 0x00,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 0x00,
  0x00, 0x00, 0x00, 0x00, 0x00, 0x00, 0x00, 0x00, 0x00, 0x00, 0x00, 0x00,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 0x00,
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  0x00, 0x20, 0x00, 0x00, 0x00, 0x00, 0x00, 0x00, 0x00, 0x00, 0x00, 0x00,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 0x41
};

static const uint8_t vfd_18x34_7[1224] = {
  0x00, 0x00, 0x00, 0x00, 0x00, 0x00, 0x00, 0x00, 0x00, 0x00, 0x00, 0x00,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 0x00,
  0x00, 0x00, 0x00, 0x00, 0x00, 0x00, 0x00, 0x00, 0x00, 0x00, 0x00, 0x00,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 0x00,
  0x00, 0x00, 0x00, 0x00, 0x00, 0x00, 0x00, 0x00, 0x00, 0x00, 0x00, 0x00,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 0x00,
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  0x00, 0x20, 0x00, 0x00, 0x00, 0x00, 0x00, 0x00, 0x00, 0x00, 0x00, 0x00,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 0x41
};

static const uint8_t vfd_18x34_8[1224] = {
  0x00, 0x00, 0x00, 0x00, 0x00, 0x00, 0x00, 0x00, 0x00, 0x00, 0x00, 0x00,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 0x00,
  0x00, 0x00, 0x00, 0x00, 0x00, 0x00, 0x00, 0x00, 0x00, 0x00, 0x00, 0x00,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 0x00,
  0x00, 0x00, 0x00, 0x00, 0x00, 0x00, 0x00, 0x00, 0x00, 0x00, 0x00, 0x00,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 0x00,
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  0x00, 0x00, 0x00, 0x00, 0x00, 0x00, 0x00, 0x00, 0x00, 0x00, 0x00, 0x00,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 0x00
};

static const uint8_t vfd_18x34_9[1224] = {
  0x00, 0x00, 0x00, 0x00, 0x00, 0x00, 0x00, 0x00, 0x00, 0x00, 0x00, 0x00,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 0x00,
  0x00, 0x00, 0x00, 0x00, 0x00, 0x00, 0x00, 0x00, 0x00, 0x00, 0x00, 0x00,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 0x00,
  0x00, 0x00, 0x00, 0x00, 0x00, 0x00, 0x00, 0x00, 0x00, 0x00, 0x00, 0x00,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 0x00,
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  0x00, 0x00, 0x00, 0x00, 0x00, 0x00, 0x00, 0x00, 0x00, 0x00, 0x00, 0x00,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 0x00
};

static const uint8_t vfd_35x67_0[4690] = {
  0x00, 0x00, 0x00, 0x00, 0x00, 0x00, 0x00, 0x00, 0x00, 0x00, 0x00, 0x00,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 0x00,
  0x00, 0x00, 0x00, 0x00, 0x00, 0x00, 0x00, 0x00, 0x00, 0x00, 0x00, 0x00,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 0x00,
  0x00, 0x00, 0x00, 0x00, 0x00, 0x00, 0x00, 0x00, 0x00, 0x00, 0x00, 0x00,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 0x00,
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  0x00, 0x00, 0x00, 0x00, 0x00, 0x00, 0x00, 0x00, 0x00, 0x00, 0x00, 0x00,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 0x20
};

static const uint8_t vfd_35x67_1[4690] = {
  0x00, 0x00, 0x00, 0x00, 0x00, 0x00, 0x00, 0x00, 0x00, 0x00, 0x00, 0x00,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 0x00,
  0x00, 0x00, 0x00, 0x00, 0x00, 0x00, 0x00, 0x00, 0x00, 0x00, 0x00, 0x00,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 0x00,
  0x00, 0x00, 0x00, 0x00, 0x00, 0x00, 0x00, 0x00, 0x00, 0x00, 0x00, 0x00,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 0x00,
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  0x10, 0xa2, 0x08, 0x41, 0x00, 0x00, 0x00, 0x00, 0x00, 0x00, 0x00, 0x00,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 0x00
};

static const uint8_t vfd_35x67_2[4690] = {
  0x00, 0x00, 0x00, 0x00, 0x00, 0x00, 0x00, 0x00, 0x00, 0x00, 0x00, 0x00,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 0x00,
  0x00, 0x00, 0x00, 0x00, 0x00, 0x00, 0x00, 0x00, 0x00, 0x00, 0x00, 0x00,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 0x00,
  0x00, 0x00, 0x00, 0x00, 0x00, 0x00, 0x00, 0x00, 0x00, 0x00, 0x00, 0x00,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 0x00,
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  0x21, 0x04, 0x18, 0xa2, 0x00, 0x00, 0x10, 0x40, 0x10, 0x60, 0x10, 0x40,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 0x20
};

static const uint8_t vfd_35x67_3[4690] = {
  0x00, 0x00, 0x00, 0x00, 0x00, 0x00, 0x00, 0x00, 0x00, 0x00, 0x00, 0x00,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 0x00,
  0x00, 0x00, 0x00, 0x00, 0x00, 0x00, 0x00, 0x00, 0x00, 0x00, 0x00, 0x00,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 0x00,
  0x00, 0x00, 0x00, 0x00, 0x00, 0x00, 0x00, 0x00, 0x00, 0x00, 0x00, 0x00,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 0x00,
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  0x21, 0x04, 0x10, 0x82, 0x00, 0x00, 0x08, 0x40, 0x08, 0x40, 0x08, 0x20,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 0x00
};

static const uint8_t vfd_35x67_4[4690] = {
  0x00, 0x00, 0x00, 0x00, 0x00, 0x00, 0x00, 0x00, 0x00, 0x00, 0x00, 0x00,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 0x00,
  0x00, 0x00, 0x00, 0x00, 0x00, 0x00, 0x00, 0x00, 0x00, 0x00, 0x00, 0x00,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 0x00,
  0x00, 0x00, 0x00, 0x00, 0x00, 0x00, 0x00, 0x00, 0x00, 0x00, 0x00, 0x00,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 0x00,
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  0x42, 0x28, 0x21, 0x24, 0x00, 0x00, 0x08, 0x40, 0x10, 0x40, 0x08, 0x40,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 0x20
};

static const uint8_t vfd_35x67_5[4690] = {
  0x00, 0x00, 0x00, 0x00, 0x00, 0x00, 0x00, 0x00, 0x00, 0x00, 0x00, 0x00,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 0x00,
  0x00, 0x00, 0x00, 0x00, 0x00, 0x00, 0x00, 0x00, 0x00, 0x00, 0x00, 0x00,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 0x00,
  0x00, 0x00, 0x00, 0x00, 0x00, 0x00, 0x00, 0x00, 0x00, 0x00, 0x00, 0x00,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 0x00,
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  0x21, 0x24, 0x08, 0x81, 0x00, 0x00, 0x08, 0x20, 0x08, 0x20, 0x08, 0x20,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 0x00
};

static const uint8_t vfd_35x67_6[4690] = {
  0x00, 0x00, 0x00, 0x00, 0x00, 0x00, 0x00, 0x00, 0x00, 0x00, 0x00, 0x00,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 0x00,
  0x00, 0x00, 0x00, 0x00, 0x00, 0x00, 0x00, 0x00, 0x00, 0x00, 0x00, 0x00,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 0x00,
  0x00, 0x00, 0x00, 0x00, 0x00, 0x00, 0x00, 0x00, 0x00, 0x00, 0x00, 0x00,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 0x00,
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  0x00, 0x20, 0x00, 0x20, 0x00, 0x00, 0x00, 0x00, 0x00, 0x00, 0x00, 0x00,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 0x20
};

static const uint8_t vfd_35x67_7[4690] = {
  0x00, 0x00, 0x00, 0x00, 0x00, 0x00, 0x00, 0x00, 0x00, 0x00, 0x00, 0x00,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 0x00,
  0x00, 0x00, 0x00, 0x00, 0x00, 0x00, 0x00, 0x00, 0x00, 0x00, 0x00, 0x00,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 0x00,
  0x00, 0x00, 0x00, 0x00, 0x00, 0x00, 0x00, 0x00, 0x00, 0x00, 0x00, 0x00,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 0x00,
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  0x00, 0x20, 0x00, 0x00, 0x00, 0x00, 0x00, 0x00, 0x00, 0x00, 0x00, 0x00,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 0x20
};

static const uint8_t vfd_35x67_8[4690] = {
  0x00, 0x00, 0x00, 0x00, 0x00, 0x00, 0x00, 0x00, 0x00, 0x00, 0x00, 0x00,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 0x00,
  0x00, 0x00, 0x00, 0x00, 0x00, 0x00, 0x00, 0x00, 0x00, 0x00, 0x00, 0x00,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 0x00,
  0x00, 0x00, 0x00, 0x00, 0x00, 0x00, 0x00, 0x00, 0x00, 0x00, 0x00, 0x00,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 0x00,
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  0x00, 0x00, 0x00, 0x00, 0x00, 0x00, 0x00, 0x00, 0x00, 0x00, 0x00, 0x00,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 0x00
};

static const uint8_t vfd_35x67_9[4690] = {
  0x00, 0x00, 0x00, 0x00, 0x00, 0x00, 0x00, 0x00, 0x00, 0x00, 0x00, 0x00,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 0x00,
  0x00, 0x00, 0x00, 0x00, 0x00, 0x00, 0x00, 0x00, 0x00, 0x00, 0x00, 0x00,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 0x00,
  0x00, 0x00, 0x00, 0x00, 0x00, 0x00, 0x00, 0x00, 0x00, 0x00, 0x00, 0x00,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 0x00,
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  0x00, 0x20, 0x00, 0x00, 0x00, 0x00, 0x00, 0x00, 0x00, 0x00, 0x00, 0x00,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 0x00
};

const int PIN_AP = 12; // Botao de Reset do WiFiManager

bool blnBotaoPressionado_M5_BUTTON_HOME = false;
bool blnBotaoPressionado_M5_BUTTON_PWR01S = false;
bool blnBotaoPressionado_M5_BUTTON_PWR02S = false;
bool blnBotaoPressionado_M5_BUTTON_RST = false;
bool blnLEDIRLigado = false;
bool blnLEDREDLigado = false;
int intIntervaloAnterior = 0;
int intIntervaloAnteriorSleep = 0;

const uint16_t maximumDistance = 1200; //mm
char *unit[] = {"mm", "cm"}; // variable for unit, mm or cm

double TensaoBateriaS;
double PercentualCargaBateria;
double temperaturaC;
uint16_t distanceMM;

RTC_TimeTypeDef RTC_TimeStruct;
RTC_DateTypeDef RTC_DateStruct;

int mode_ = 3; // 3:2Lines 2: 2Lines(YYMM), 1:1Line
const uint8_t*n[] = { // vfd font 18x34
  vfd_18x34_0, vfd_18x34_1, vfd_18x34_2, vfd_18x34_3, vfd_18x34_4,
  vfd_18x34_5, vfd_18x34_6, vfd_18x34_7, vfd_18x34_8, vfd_18x34_9
};
const uint8_t*m[] = { // vfd font 35x67
  vfd_35x67_0, vfd_35x67_1, vfd_35x67_2, vfd_35x67_3, vfd_35x67_4,
  vfd_35x67_5, vfd_35x67_6, vfd_35x67_7, vfd_35x67_8, vfd_35x67_9
};
const char *monthName[12] = {
  "Jan", "Feb", "Mar", "Apr", "May", "Jun",
  "Jul", "Aug", "Sep", "Oct", "Nov", "Dec"
};

// Variables will change:
int lastState_M5_BUTTON_HOME = LOW;  // the previous state from the input pin
int currentState_M5_BUTTON_HOME;     // the current reading from the input pin

VL53L0X sensor;

// Replace with your network credentials
char* ssid = "TIM ULTRAFIBRA_2G0";
char* password = "723564";

// NTP server to request epoch time
const char* ntpServer = "pool.ntp.org";

//Fuso Horário, no caso horário de verão de Brasília
int timeZone = -3;

//Struct com os dados do dia e hora
struct Date {
  int dayOfWeek;
  int day;
  int month;
  int year;
  int hours;
  int minutes;
  int seconds;
};

//Socket UDP que a lib utiliza para recuperar dados sobre o horário
WiFiUDP udp;

//Objeto responsável por recuperar dados sobre horário
NTPClient ntpClient(
  udp,                    //socket udp
  "0.br.pool.ntp.org",    //URL do servwer NTP
  timeZone * 3600,        //Deslocamento do horário em relacão ao GMT 0
  60000);                 //Intervalo entre verificações online

//Nomes dos dias da semana
char* dayOfWeekNames[] = {"Sunday", "Monday", "Tuesday", "Wednesday", "Thursday", "Friday", "Saturday"};

// #define BUTTON_PIN_BITMASK 0xA000000000 // Motando a mascara (2^39 + 2^37 = 0xA000000000) em Hexadecimal - Button A (GPIO 37); Button B (GPIO 39)
// #define uS_TO_S_FACTOR 1000000  /* Conversion factor for micro seconds to seconds */
// #define TIME_TO_SLEEP  5        /* Time ESP32 will go to sleep (in seconds) */

RTC_DATA_ATTR int bootCount = 0;

void connectWiFi();
void vfd_1_line();
void vfd_2_line();
void vfd_3_line();
void vfd_4_line();
void vfd_5_line();
void vfd_6_line();
void fade();

void print_wakeup_reason()
{
  esp_sleep_wakeup_cause_t wakeup_reason;

  wakeup_reason = esp_sleep_get_wakeup_cause();

  switch(wakeup_reason)
  {
    case ESP_SLEEP_WAKEUP_EXT0 : Serial.println("Wakeup caused by external signal using RTC_IO"); break;
    case ESP_SLEEP_WAKEUP_EXT1 : Serial.println("Wakeup caused by external signal using RTC_CNTL"); break;
    case ESP_SLEEP_WAKEUP_TIMER : Serial.println("Wakeup caused by timer"); break;
    case ESP_SLEEP_WAKEUP_TOUCHPAD : Serial.println("Wakeup caused by touchpad"); break;
    case ESP_SLEEP_WAKEUP_ULP : Serial.println("Wakeup caused by ULP program"); break;
    default : Serial.printf("Wakeup was not caused by deep sleep: %d\n",wakeup_reason); break;
  }
}

/*
Method to print the GPIO that triggered the wakeup
*/
void print_GPIO_wake_up()
{
  uint64_t GPIO_reason = esp_sleep_get_ext1_wakeup_status();
  Serial.print("GPIO that triggered the wake up: GPIO ");
  Serial.println((log(GPIO_reason))/log(2), 0);
}

void mtdDeepSleep(gpio_num_t PIN)
{
  // Rewrite M5.Axp.DeepSleep() in order to enable ext0 wakep up.
  esp_sleep_enable_ext0_wakeup(PIN, LOW);
  esp_sleep_pd_config(ESP_PD_DOMAIN_RTC_PERIPH, ESP_PD_OPTION_AUTO);
  // esp_sleep_enable_ext1_wakeup(BUTTON_PIN_BITMASK, ESP_EXT1_WAKEUP_ANY_HIGH);
  esp_wifi_stop();
  adc_power_off();
  M5.Axp.SetSleep();
  esp_deep_sleep_start();
}

void setupNTP()
{
  //Inicializa o client NTP
  ntpClient.begin();

  //Espera pelo primeiro update online
  Serial.println("Waiting for first update");
  while (!ntpClient.update())
  {
    Serial.print(".");
    ntpClient.forceUpdate();
    delay(500);
  }

  Serial.println();
  Serial.println("First Update Complete");
}

//Tarefa que verifica se a conexão caiu e tenta reconectar
void wifiConnectionTask(void* param)
{
  while (true)
  {
    //Se a WiFi não está conectada
    if (WiFi.status() != WL_CONNECTED)
    {
      //Manda conectar
      connectWiFi();
    }

    //Delay de 100 ticks
    vTaskDelay(100);
  }
}

void connectWiFi()
{
  Serial.println("Connecting");

  //Troque pelo nome e senha da sua rede WiFi
  WiFi.begin(ssid, password);

  //Espera enquanto não estiver conectado
  while (WiFi.status() != WL_CONNECTED)
  {
    Serial.print(".");
    delay(500);
  }

  Serial.println();
  Serial.print("Connected to ");
  Serial.println(WiFi.SSID());
}

Date getDate()
{
  //Recupera os dados de data e horário usando o client NTP
  char* strDate = (char*)ntpClient.getFormattedDate().c_str();

  //Passa os dados da string para a struct
  Date date;
  sscanf(strDate, "%d-%d-%dT%d:%d:%dZ",
         &date.year,
         &date.month,
         &date.day,
         &date.hours,
         &date.minutes,
         &date.seconds);

  //Dia da semana de 0 a 6, sendo 0 o domingo
  date.dayOfWeek = ntpClient.getDay();
  return date;
}

double mtdObterNivelBateria(double TensaoBateria)
{
  double Retorno = 0;

  if (TensaoBateria > 4.1)
  {
    Retorno = (90 + ((TensaoBateria - 4.1) / (4.2 - 4.1)) * 10);
  }
  if (TensaoBateria <= 4.1 & TensaoBateria > 4.0)
  {
    Retorno = (80 + ((TensaoBateria - 4.0) / (4.1 - 4.0)) * 10);
  }
  if (TensaoBateria <= 4.0 & TensaoBateria > 3.9)
  {
    Retorno = (60 + ((TensaoBateria - 3.9) / (4.0 - 3.9)) * 20);
  }
  if (TensaoBateria <= 3.9 & TensaoBateria > 3.8)
  {
    Retorno = (40 + ((TensaoBateria - 3.8) / (3.9 - 3.8)) * 20);
  }
  if (TensaoBateria <= 3.8 & TensaoBateria > 3.7)
  {
    Retorno = (20 + ((TensaoBateria - 3.7) / (3.8 - 3.7)) * 20);
  }
  if (TensaoBateria <= 3.7 & TensaoBateria > 3.6)
  {
    Retorno = (00 + ((TensaoBateria - 3.6) / (3.7 - 3.6)) * 20);
  }

  return Retorno;
}

void setup_WiFiManager()
{
  pinMode(PIN_AP, INPUT);
  //declaração do objeto wifiManager
  WiFiManager wifiManager;

  //utilizando esse comando, as configurações são apagadas da memória
  //caso tiver salvo alguma rede para conectar automaticamente, ela é apagada.
  wifiManager.resetSettings();

//callback para quando entra em modo de configuração AP
  wifiManager.setAPCallback(configModeCallback); 
//callback para quando se conecta em uma rede, ou seja, quando passa a trabalhar em modo estação
  wifiManager.setSaveConfigCallback(saveConfigCallback); 

//cria uma rede de nome ESP_AP com senha 12345678
  wifiManager.autoConnect("ESP_AP", "12345678"); 
}

void loop_WiFiManager() 
{
   if ( digitalRead(PIN_AP) == HIGH ) 
   {
      WiFiManager wifiManager;
      if(!wifiManager.startConfigPortal("ESP_AP", "12345678") )
      {
        Serial.println("Falha ao conectar");
        delay(2000);
        ESP.restart();
      }
   }
}

//callback que indica que o ESP entrou no modo AP
void configModeCallback(WiFiManager *myWiFiManager) 
{  
  //  Serial.println("Entered config mode");
  Serial.println("Entrou no modo de configuração");
  Serial.println(WiFi.softAPIP()); //imprime o IP do AP
  Serial.println(myWiFiManager->getConfigPortalSSID()); //imprime o SSID criado da rede
}

//callback que indica que salvamos uma nova rede para se conectar (modo estação)
void saveConfigCallback() 
{
  Serial.println("Configuração salva");
}

void setup(void)
{
  Serial.begin(115200);
  delay(10000);
  ESP.restart();
  
  if (bootCount == 0)
  {
    // connectWiFi();
      
    //Cria uma nova tarefa no core 0
    // xTaskCreatePinnedToCore(
        // wifiConnectionTask,     //Função que será executada
        // "wifiConnectionTask",   //Nome da tarefa
        // 10000,                  //Tamanho da memória disponível (em WORDs)
        // NULL,                   //Não vamos passar nenhum parametro
        // 2,                      //prioridade
        // NULL,                   //Não precisamos de referência para a tarefa
        // 0);                     //Número do core
    
    setup_WiFiManager();
  
    if(WiFi.status() == WL_CONNECTED)
    {
      setupNTP();
    }
  }

  //Recupera os dados sobre a data e horário
  Date date = getDate();

  M5.begin();
  pinMode(M5_BUTTON_HOME, INPUT_PULLUP);
  M5.Lcd.fillScreen(BLACK);
  M5.Lcd.setRotation(1);
  M5.Axp.ScreenBreath(10);             // 7-15
  // rtc setup start ---------------------------------------------
  String pt = (__DATE__ " " __TIME__); // PC DATE TIME READ
  //000000000011111111112  Read data
  //012345678901234567890
  //Jun  6 2019 07:20:41
  char m1[3]; int  m2; // Month conversion ( Jun to 6 )
  (pt.substring(0, 3)).toCharArray(m1, 4);
  for (int mx = 0; mx < 12; mx ++) {
    if (strcmp(m1, monthName[mx]) == 0) {
      m2 = mx + 1;
      break;
    }
  }
  RTC_DateTypeDef DateStruct;         // Month, Date, Year
  // DateStruct.Month   = m2;
  // DateStruct.Date    = (pt.substring(4, 6)).toInt();
  // DateStruct.Year    = (pt.substring(7,11)).toInt();
  DateStruct.Month   = date.month;
  DateStruct.Date    = date.day;
  DateStruct.Year    = date.year;
  M5.Rtc.SetData(&DateStruct);
  RTC_TimeTypeDef TimeStruct;         // Hours, Minutes, Seconds
  // TimeStruct.Hours   = (pt.substring(12,14)).toInt();
  // TimeStruct.Minutes = (pt.substring(15,17)).toInt();
  // TimeStruct.Seconds = (pt.substring(18,20)).toInt();
  TimeStruct.Hours   = date.hours;
  TimeStruct.Minutes = date.minutes;
  TimeStruct.Seconds = date.seconds;
  M5.Rtc.SetTime(&TimeStruct);
  // rtc setup end -----------------------------------------------

  Wire.begin(0, 26, 100000UL);

  sensor.setTimeout(500);
  if (!sensor.init())
  {
    while (1)
    {
    }
  }

  // Start continuous back-to-back mode (take readings as
  // fast as possible).  To use continuous timed mode
  // instead, provide a desired inter-measurement period in
  // ms (e.g. sensor.startContinuous(100)).
  sensor.startContinuous();

  pinMode(9, OUTPUT);
  digitalWrite(9, HIGH);
  pinMode(10, OUTPUT);
  digitalWrite(10, HIGH);

  //Increment boot number and print it every reboot
  ++bootCount;
  Serial.println("Boot number: " + String(bootCount));

  // Print the wakeup reason for ESP32
  // print_wakeup_reason();

  // Print the GPIO used to wake up
  //  print_GPIO_wake_up();

  /*
  First we configure the wake up source
  We set our ESP32 to wake up every 5 seconds
  */
  // esp_sleep_enable_timer_wakeup(TIME_TO_SLEEP * uS_TO_S_FACTOR);
  // Serial.println("Setup ESP32 to sleep for every " + String(TIME_TO_SLEEP) + " Seconds");
}

void loop(void)
{
  // if(WiFi.status() != WL_CONNECTED)
  // {
  loop_WiFiManager();
  // }

  M5.Rtc.GetTime(&RTC_TimeStruct);
  // M5.Rtc.GetData(&RTC_DateStruct);

  // read the state of the switch/button:
  currentState_M5_BUTTON_HOME = digitalRead(M5_BUTTON_HOME);

  if (lastState_M5_BUTTON_HOME == HIGH && currentState_M5_BUTTON_HOME == LOW)
  {
    blnBotaoPressionado_M5_BUTTON_HOME = true;
    intIntervaloAnteriorSleep = millis();
  }

  if (M5.Axp.GetBtnPress() == 0x02)
  {
    blnBotaoPressionado_M5_BUTTON_PWR01S = true;
    intIntervaloAnteriorSleep = millis();
  }

  if (M5.Axp.GetBtnPress() == 0x01)
  {
    blnBotaoPressionado_M5_BUTTON_PWR02S = true;
    intIntervaloAnteriorSleep = millis();
  }

  if (millis() - intIntervaloAnterior >= 100)
  {
    intIntervaloAnterior = millis();

    // save the the last state
    lastState_M5_BUTTON_HOME = currentState_M5_BUTTON_HOME;

    if ( mode_ == 6 ) {
      vfd_6_line(); // temperature
    }
    if ( mode_ == 5 ) {
      vfd_5_line(); // temperature
    }
    if ( mode_ == 4 ) {
      vfd_4_line(); // sensor distance meter
    }
    if ( mode_ == 3 ) {
      vfd_3_line(); // hh,mm,ss
    }
    if ( mode_ == 2 ) {
      vfd_2_line(); // yyyy,mm,dd,hh,mm,ss
    }
    if ( mode_ == 1 ) {
      vfd_1_line(); // mm,ss
    }

    if (blnBotaoPressionado_M5_BUTTON_HOME)
    {
      blnBotaoPressionado_M5_BUTTON_HOME = false;

      if (mode_ == 6) {
        mode_ = 1;
        M5.Lcd.fillScreen(BLACK);
        return;
      }
      if (mode_ == 5) {
        mode_ = 6;
        M5.Lcd.fillScreen(BLACK);
        return;
      }
      if (mode_ == 4) {
        mode_ = 5;
        M5.Lcd.fillScreen(BLACK);
        return;
      }
      if (mode_ == 3) {
        mode_ = 4;
        M5.Lcd.fillScreen(BLACK);
        return;
      }
      if (mode_ == 2) {
        mode_ = 3;
        M5.Lcd.fillScreen(BLACK);
        return;
      }
      if (mode_ == 1) {
        mode_ = 2;
        M5.Lcd.fillScreen(BLACK);
        return;
      }
    }

    if (blnBotaoPressionado_M5_BUTTON_PWR01S)
    {
      blnBotaoPressionado_M5_BUTTON_PWR01S = false;
      
      if (blnLEDREDLigado)
      {
        digitalWrite(10, LOW);
        blnLEDREDLigado = false;
      }
      else
      {
        digitalWrite(10, HIGH);
        blnLEDREDLigado = true;
      }
    }

    if (blnBotaoPressionado_M5_BUTTON_PWR02S)
    {
      blnBotaoPressionado_M5_BUTTON_PWR02S = false;

      if (blnLEDIRLigado)
      {
        digitalWrite(9, LOW);
        blnLEDIRLigado = false;
      }
      else
      {
        digitalWrite(9, HIGH);
        blnLEDIRLigado = true;
      }
    }

    if (millis() - intIntervaloAnteriorSleep >= 60000)
    {
      intIntervaloAnteriorSleep = millis();
      mtdDeepSleep(GPIO_NUM_37);
    }
  }
}

void vfd_6_line()
{
  TensaoBateriaS =  M5.Axp.GetBatVoltage();
  PercentualCargaBateria = mtdObterNivelBateria(TensaoBateriaS) * 10;

  M5.Rtc.GetTime(&RTC_TimeStruct);
  M5.Rtc.GetData(&RTC_DateStruct);

  int d1 = int(PercentualCargaBateria / 1000);
  int d2 = int((PercentualCargaBateria - d1 * 1000) / 100);
  int d3 = int((PercentualCargaBateria - d1 * 1000 - d2 * 100) / 10);
  int d4 = int(PercentualCargaBateria - d1 * 1000 - d2 * 100 - d3 * 10);

  M5.Rtc.GetTime(&RTC_TimeStruct);
  M5.Rtc.GetData(&RTC_DateStruct);
  int h1 = int(RTC_TimeStruct.Hours / 10 );
  int h2 = int(RTC_TimeStruct.Hours - h1 * 10 );
  int i1 = int(RTC_TimeStruct.Minutes / 10 );
  int i2 = int(RTC_TimeStruct.Minutes - i1 * 10 );
  int s1 = int(RTC_TimeStruct.Seconds / 10 );
  int s2 = int(RTC_TimeStruct.Seconds - s1 * 10 );

  M5.Lcd.pushImage(  2, 0, 35, 67, (uint16_t *)m[h1]);
  M5.Lcd.pushImage( 41, 0, 35, 67, (uint16_t *)m[h2]);
  M5.Lcd.drawPixel( 79, 22, ORANGE); M5.Lcd.drawPixel( 79, 48, ORANGE);
  M5.Lcd.drawPixel( 79, 21, YELLOW); M5.Lcd.drawPixel( 79, 47, YELLOW);
  M5.Lcd.pushImage( 83, 0, 35, 67, (uint16_t *)m[i1]);
  M5.Lcd.pushImage(121, 0, 35, 67, (uint16_t *)m[i2]);
  M5.Lcd.pushImage(140, 45, 18, 34, (uint16_t *)n[d4]);
  M5.Lcd.drawPixel(139, 74, ORANGE);
  M5.Lcd.drawPixel(139, 73, YELLOW);  
  M5.Lcd.pushImage(120, 45, 18, 34, (uint16_t *)n[d3]);
  M5.Lcd.pushImage(100, 45, 18, 34, (uint16_t *)n[d2]);
  // M5.Lcd.drawPixel(99, 74, ORANGE);
  // M5.Lcd.drawPixel(99, 73, YELLOW);
  M5.Lcd.pushImage(80, 45, 18, 34, (uint16_t *)n[d1]);

  // if ( s1 == 0 && s2 == 0 ){ fade();}
}

void vfd_5_line()
{
  temperaturaC = M5.Axp.GetTempInAXP192();

  M5.Rtc.GetTime(&RTC_TimeStruct);
  M5.Rtc.GetData(&RTC_DateStruct);

  int d1 = int(temperaturaC / 100);
  int d2 = int((temperaturaC - d1 * 100) / 10);
  int d3 = int((temperaturaC - d1 * 100 - d2 * 10) / 1);
  int d4 = int((temperaturaC - d1 * 100 - d2 * 10 - d3 * 1) * 10);

  M5.Rtc.GetTime(&RTC_TimeStruct);
  M5.Rtc.GetData(&RTC_DateStruct);
  int h1 = int(RTC_TimeStruct.Hours / 10 );
  int h2 = int(RTC_TimeStruct.Hours - h1 * 10 );
  int i1 = int(RTC_TimeStruct.Minutes / 10 );
  int i2 = int(RTC_TimeStruct.Minutes - i1 * 10 );
  int s1 = int(RTC_TimeStruct.Seconds / 10 );
  int s2 = int(RTC_TimeStruct.Seconds - s1 * 10 );

  M5.Lcd.pushImage(  2, 0, 35, 67, (uint16_t *)m[h1]);
  M5.Lcd.pushImage( 41, 0, 35, 67, (uint16_t *)m[h2]);
  M5.Lcd.drawPixel( 79, 22, ORANGE); M5.Lcd.drawPixel( 79, 48, ORANGE);
  M5.Lcd.drawPixel( 79, 21, YELLOW); M5.Lcd.drawPixel( 79, 47, YELLOW);
  M5.Lcd.pushImage( 83, 0, 35, 67, (uint16_t *)m[i1]);
  M5.Lcd.pushImage(121, 0, 35, 67, (uint16_t *)m[i2]);
  M5.Lcd.pushImage(140, 45, 18, 34, (uint16_t *)n[d4]);
  M5.Lcd.drawPixel(139, 74, ORANGE);
  M5.Lcd.drawPixel(139, 73, YELLOW);
  M5.Lcd.pushImage(120, 45, 18, 34, (uint16_t *)n[d3]);
  M5.Lcd.pushImage(100, 45, 18, 34, (uint16_t *)n[d2]);
  M5.Lcd.pushImage(80, 45, 18, 34, (uint16_t *)n[d1]);

  // if ( s1 == 0 && s2 == 0 ){ fade();}
}

void vfd_4_line()
{
  distanceMM = sensor.readRangeContinuousMillimeters() - 30; //get the distance in mm

  if (distanceMM > maximumDistance)
  {
    distanceMM = 0;
  }

  M5.Rtc.GetTime(&RTC_TimeStruct);
  M5.Rtc.GetData(&RTC_DateStruct);

  int d1 = int(distanceMM / 1000);
  int d2 = int((distanceMM - d1 * 1000) / 100);
  int d3 = int((distanceMM - d1 * 1000 - d2 * 100) / 10);
  int d4 = int(distanceMM - d1 * 1000 - d2 * 100 - d3 * 10);

  M5.Rtc.GetTime(&RTC_TimeStruct);
  M5.Rtc.GetData(&RTC_DateStruct);
  int h1 = int(RTC_TimeStruct.Hours / 10 );
  int h2 = int(RTC_TimeStruct.Hours - h1 * 10 );
  int i1 = int(RTC_TimeStruct.Minutes / 10 );
  int i2 = int(RTC_TimeStruct.Minutes - i1 * 10 );
  int s1 = int(RTC_TimeStruct.Seconds / 10 );
  int s2 = int(RTC_TimeStruct.Seconds - s1 * 10 );

  M5.Lcd.pushImage(  2, 0, 35, 67, (uint16_t *)m[h1]);
  M5.Lcd.pushImage( 41, 0, 35, 67, (uint16_t *)m[h2]);
  M5.Lcd.drawPixel( 79, 22, ORANGE); M5.Lcd.drawPixel( 79, 48, ORANGE);
  M5.Lcd.drawPixel( 79, 21, YELLOW); M5.Lcd.drawPixel( 79, 47, YELLOW);
  M5.Lcd.pushImage( 83, 0, 35, 67, (uint16_t *)m[i1]);
  M5.Lcd.pushImage(121, 0, 35, 67, (uint16_t *)m[i2]);
  M5.Lcd.pushImage(140, 45, 18, 34, (uint16_t *)n[d4]);
  M5.Lcd.pushImage(120, 45, 18, 34, (uint16_t *)n[d3]);
  M5.Lcd.pushImage(100, 45, 18, 34, (uint16_t *)n[d2]);
  M5.Lcd.pushImage(80, 45, 18, 34, (uint16_t *)n[d1]);

  // if ( s1 == 0 && s2 == 0 ){ fade();}
}

void vfd_3_line() {
  M5.Rtc.GetTime(&RTC_TimeStruct);
  M5.Rtc.GetData(&RTC_DateStruct);
  int h1 = int(RTC_TimeStruct.Hours / 10 );
  int h2 = int(RTC_TimeStruct.Hours - h1 * 10 );
  int i1 = int(RTC_TimeStruct.Minutes / 10 );
  int i2 = int(RTC_TimeStruct.Minutes - i1 * 10 );
  int s1 = int(RTC_TimeStruct.Seconds / 10 );
  int s2 = int(RTC_TimeStruct.Seconds - s1 * 10 );

  M5.Lcd.pushImage(  2, 0, 35, 67, (uint16_t *)m[h1]);
  M5.Lcd.pushImage( 41, 0, 35, 67, (uint16_t *)m[h2]);
  M5.Lcd.drawPixel( 79, 22, ORANGE); M5.Lcd.drawPixel( 79, 48, ORANGE);
  M5.Lcd.drawPixel( 79, 21, YELLOW); M5.Lcd.drawPixel( 79, 47, YELLOW);
  M5.Lcd.pushImage( 83, 0, 35, 67, (uint16_t *)m[i1]);
  M5.Lcd.pushImage(121, 0, 35, 67, (uint16_t *)m[i2]);
  M5.Lcd.pushImage(120, 45, 18, 34, (uint16_t *)n[s1]);
  M5.Lcd.pushImage(140, 45, 18, 34, (uint16_t *)n[s2]);

  if ( s1 == 0 && s2 == 0 ) {
    fade();
  }
}

void vfd_2_line() {
  M5.Rtc.GetTime(&RTC_TimeStruct);
  M5.Rtc.GetData(&RTC_DateStruct);
  //Serial.printf("Data: %04d-%02d-%02d\n",RTC_DateStruct.Year,RTC_DateStruct.Month,RTC_DateStruct.Date);
  //Serial.printf("Week: %d\n",RTC_DateStruct.WeekDay);
  //Serial.printf("Time: %02d : %02d : %02d\n",RTC_TimeStruct.Hours,RTC_TimeStruct.Minutes,RTC_TimeStruct.Seconds);
  // Data: 2019-06-06
  // Week: 0
  // Time: 09 : 55 : 26
  int y1 = int(RTC_DateStruct.Year    / 1000 );
  int y2 = int((RTC_DateStruct.Year   - y1 * 1000 ) / 100 );
  int y3 = int((RTC_DateStruct.Year   - y1 * 1000 - y2 * 100 ) / 10 );
  int y4 = int(RTC_DateStruct.Year    - y1 * 1000 - y2 * 100 - y3 * 10 );
  int j1 = int(RTC_DateStruct.Month   / 10);
  int j2 = int(RTC_DateStruct.Month   - j1 * 10 );
  int d1 = int(RTC_DateStruct.Date    / 10 );
  int d2 = int(RTC_DateStruct.Date    - d1 * 10 );
  int h1 = int(RTC_TimeStruct.Hours   / 10) ;
  int h2 = int(RTC_TimeStruct.Hours   - h1 * 10 );
  int i1 = int(RTC_TimeStruct.Minutes / 10 );
  int i2 = int(RTC_TimeStruct.Minutes - i1 * 10 );
  int s1 = int(RTC_TimeStruct.Seconds / 10 );
  int s2 = int(RTC_TimeStruct.Seconds - s1 * 10 );

  M5.Lcd.pushImage(  0, 0, 18, 34, (uint16_t *)n[y1]);
  M5.Lcd.pushImage( 19, 0, 18, 34, (uint16_t *)n[y2]);
  M5.Lcd.pushImage( 38, 0, 18, 34, (uint16_t *)n[y3]);
  M5.Lcd.pushImage( 57, 0, 18, 34, (uint16_t *)n[y4]);
  M5.Lcd.drawPixel( 77, 13, ORANGE); M5.Lcd.drawPixel( 77, 23, ORANGE);
  M5.Lcd.pushImage( 80, 0, 18, 34, (uint16_t *)n[j1]);
  M5.Lcd.pushImage( 99, 0, 18, 34, (uint16_t *)n[j2]);
  M5.Lcd.drawPixel(118, 13, ORANGE); M5.Lcd.drawPixel(119, 23, ORANGE);
  M5.Lcd.pushImage(120, 0, 18, 34, (uint16_t *)n[d1]);
  M5.Lcd.pushImage(140, 0, 18, 34, (uint16_t *)n[d2]);

  M5.Lcd.pushImage( 00, 40, 18, 34, (uint16_t *)n[h1]);
  M5.Lcd.pushImage( 20, 40, 18, 34, (uint16_t *)n[h2]);
  M5.Lcd.drawPixel( 48, 54, ORANGE); M5.Lcd.drawPixel( 48, 64, ORANGE);
  M5.Lcd.pushImage( 60, 40, 18, 34, (uint16_t *)n[i1]);
  M5.Lcd.pushImage( 80, 40, 18, 34, (uint16_t *)n[i2]);
  M5.Lcd.drawPixel(108, 54, ORANGE); M5.Lcd.drawPixel(108, 64, ORANGE);
  M5.Lcd.pushImage(120, 40, 18, 34, (uint16_t *)n[s1]);
  M5.Lcd.pushImage(140, 40, 18, 34, (uint16_t *)n[s2]);

  if ( i1 == 0 && i2 == 0 ) {
    fade();
  }
}

void vfd_1_line() {
  M5.Rtc.GetTime(&RTC_TimeStruct);
  M5.Rtc.GetData(&RTC_DateStruct);
  int i1 = int(RTC_TimeStruct.Minutes / 10 );
  int i2 = int(RTC_TimeStruct.Minutes - i1 * 10 );
  int s1 = int(RTC_TimeStruct.Seconds / 10 );
  int s2 = int(RTC_TimeStruct.Seconds - s1 * 10 );

  M5.Lcd.pushImage(  2, 6, 35, 67, (uint16_t *)m[i1]);
  M5.Lcd.pushImage( 41, 6, 35, 67, (uint16_t *)m[i2]);
  M5.Lcd.drawPixel( 79, 28, ORANGE); M5.Lcd.drawPixel( 79, 54, ORANGE);
  M5.Lcd.drawPixel( 79, 27, YELLOW); M5.Lcd.drawPixel( 79, 53, YELLOW);
  M5.Lcd.pushImage( 83, 6, 35, 67, (uint16_t *)m[s1]);
  M5.Lcd.pushImage(121, 6, 35, 67, (uint16_t *)m[s2]);

  if ( s1 == 0 && s2 == 0 ) {
    fade();
  }
}

void fade() {
  for (int i = 7; i < 16; i++) {
    M5.Axp.ScreenBreath(i);
    delay(25);
  }
  for (int i = 15; i > 7; i--) {
    M5.Axp.ScreenBreath(i);
    delay(25);
  }
  M5.Axp.ScreenBreath(12);
}
